#include <WiFi.h>
#include <WebServer.h>
#include <ArduinoJson.h>

#include "config.h"
#include "web_app.h"   // Generated by scripts/embed_webapp.py

WebServer server(80);


// ── helpers ──────────────────────────────────────────────────────────────────

bool checkPassword(const String& body) {
  StaticJsonDocument<256> doc;
  DeserializationError err = deserializeJson(doc, body);
  if (err) return false;
  return String((const char*)doc["password"]) == DOOR_PASSWORD;
}

void sendJson(int code, const String& payload) {
  server.send(code, "application/json", payload);
}

// ── route handlers ────────────────────────────────────────────────────────────

void handleRoot() {
  server.send_P(200, "text/html", INDEX_HTML);
}

void handleOpen() {
  if (!checkPassword(server.arg("plain"))) {
    sendJson(401, "{\"ok\":false,\"error\":\"Wrong password\"}");
    return;
  }
  digitalWrite(RELAY_PIN, HIGH);
  delay(RELAY_PULSE_MS);
  digitalWrite(RELAY_PIN, LOW);
  sendJson(200, "{\"ok\":true}");
  Serial.println("Door unlocked (relay pulsed).");
}

void handleNotFound() {
  sendJson(404, "{\"ok\":false,\"error\":\"Not found\"}");
}

// ── setup & loop ──────────────────────────────────────────────────────────────

void setup() {
  Serial.begin(115200);

  pinMode(RELAY_PIN, OUTPUT);
  digitalWrite(RELAY_PIN, LOW);

  // Connect to WiFi
  Serial.printf("Connecting to %s", WIFI_SSID);
  WiFi.begin(WIFI_SSID, WIFI_PASSWORD);
  while (WiFi.status() != WL_CONNECTED) {
    delay(500);
    Serial.print(".");
  }
  Serial.printf("\nConnected. IP: %s\n", WiFi.localIP().toString().c_str());

  // Register routes
  server.on("/",          HTTP_GET,  handleRoot);
  server.on("/api/open",  HTTP_POST, handleOpen);
  server.onNotFound(handleNotFound);

  server.begin();
  Serial.println("HTTP server started.");
}

void loop() {
  server.handleClient();
}
